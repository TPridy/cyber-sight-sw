## yocto/build/conf/bblayers.conf
```bitbake
# POKY_BBLAYERS_CONF_VERSION is increased each time build/conf/bblayers.conf
# changes incompatibly
POKY_BBLAYERS_CONF_VERSION = "2"

BBPATH = "${TOPDIR}"
BBFILES ?= ""

YOCTOROOT = "${@os.path.abspath(os.path.join("${TOPDIR}", os.pardir))}"

BBLAYERS ?= "                                               \
  ${YOCTOROOT}/poky/meta                                    \
  ${YOCTOROOT}/poky/meta-poky                               \
  ${YOCTOROOT}/poky/meta-yocto-bsp                          \
  ${YOCTOROOT}/layers/meta-openembedded/meta-oe             \
  ${YOCTOROOT}/layers/meta-openembedded/meta-python         \
  ${YOCTOROOT}/layers/meta-st-stm32mp                       \
  "

BBLAYERS_NON_REMOVABLE ?= " \
  ${YOCTOROOT}/poky/meta \
  ${YOCTOROOT}/poky/meta-poky \
"
```

## yocto/layers/meta-cybersight/conf/layer.conf
```bitbake
# We have a conf and classes directory, add to BBPATH
BBPATH .= ":${LAYERDIR}"

# We have recipes-* directories, add to BBFILES
BBFILES += "${LAYERDIR}/recipes-*/*/*.bb \
            ${LAYERDIR}/recipes-*/*/*.bbappend"

BBFILE_COLLECTIONS += "meta-cybersight"
BBFILE_PATTERN_meta-cybersight = "^${LAYERDIR}/"
BBFILE_PRIORITY_meta-cybersight = "6"

LAYERDEPENDS_meta-cybersight = "core"
LAYERSERIES_COMPAT_meta-cybersight = "dunfell"
```
